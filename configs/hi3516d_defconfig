## configs/hi3516d_defconfig
```kconfig
BR2_arm=y
BR2_cortex_a7=y

# BR2_ARM_EABI is not set
BR2_ARM_EABIHF=y
BR2_ARM_FPU_NEON_VFPV4=y
BR2_ARM_INSTRUCTIONS_THUMB2=y

BR2_OPTIMIZE_2=y

BR2_CCACHE=y

BR2_TOOLCHAIN_BUILDROOT_EGLIBC=y
BR2_TOOLCHAIN_BUILDROOT_LARGEFILE=y
BR2_TOOLCHAIN_BUILDROOT_CXX=y
BR2_TOOLCHAIN_BUILDROOT_WCHAR=y
BR2_TOOLCHAIN_BUILDROOT_LOCALE=y

BR2_GCC_VERSION_9_X=y
#BR2_GCC_VERSION_4_9_X=y
BR2_TARGET_OPTIMIZATION="-pipe -mhard-float -mfloat-abi=hard -mfpu=neon-vfpv4 -march=armv7-a -mtune=cortex-a7 -fsigned-char"

BR2_TARGET_GENERIC_HOSTNAME="tryllptz"
BR2_TARGET_GENERIC_ISSUE="Welcome to TryllPTZ"
BR2_TARGET_ROOTFS_SQUASHFS=y
BR2_TARGET_ROOTFS_SQUASHFS4_XZ=y
BR2_TARGET_ROOTFS_TAR_XZ=y

BR2_ROOTFS_DEVICE_CREATION_DYNAMIC_EUDEV=y
BR2_ROOTFS_OVERLAY="board/hisilicon/hi3516d/fs-overlay"

BR2_LINUX_KERNEL=y
BR2_LINUX_KERNEL_CUSTOM_LOCAL=y
BR2_LINUX_KERNEL_CUSTOM_LOCAL_PATH="linux/linux-3.4.y"
BR2_LINUX_KERNEL_USE_CUSTOM_CONFIG=y
BR2_LINUX_KERNEL_CUSTOM_CONFIG_FILE="board/hisilicon/hi3516d/linux-3.4.config"
BR2_LINUX_KERNEL_UIMAGE=y
BR2_LINUX_KERNEL_XZ=y

BR2_PACKAGE_BUSYBOX_CONFIG="board/hisilicon/hi3516d/busybox.config"

BR2_PACKAGE_DROPBEAR=y
BR2_PACKAGE_DROPBEAR_CLIENT=y
BR2_PACKAGE_DROPBEAR_DISABLE_REVERSEDNS=y
BR2_PACKAGE_DROPBEAR_SMALL=y

BR2_PACKAGE_MTD=y
BR2_PACKAGE_MTD_JFFS_UTILS=y
BR2_PACKAGE_MTD_UBIFS_UTILS=n

BR2_PACKAGE_UBOOT_TOOLS=y

#Live streamer does not support MUSL :(
#BR2_PACKAGE_LIVE_STREAMER=y
#BR2_PACKAGE_BITSTREAM_VERA=y
#SDK for HI3516A must be added and checked for build support for CPU selected above and MUSL
#BR2_PACKAGE_HIMPP=y
#BR2_PACKAGE_HIMPP_HI3518V100=y

#Disabling UBOOT - what about Bearbox!?
#BR2_TARGET_UBOOT=y
#BR2_TARGET_UBOOT_BOARDNAME="hi3516d"
#BR2_TARGET_UBOOT_CUSTOM_LOCAL=y
#BR2_TARGET_UBOOT_CUSTOM_LOCAL_PATH="boot/uboot/u-boot-2010.06"
#BR2_TARGET_UBOOT_HI35XX_IMAGE=y
#BR2_TARGET_UBOOT_HI35XX_IMAGE_CH_FILE="board/hisilicon/hi3516d/boot/reg_info_hi3516c.bin"
#BR2_TARGET_UBOOT_ENVIMAGE=y
#BR2_TARGET_UBOOT_ENVIMAGE_SOURCE="board/hisilicon/hi3516d/uboot-env.txt"
#BR2_TARGET_UBOOT_ENVIMAGE_SIZE="0x40000"
```
